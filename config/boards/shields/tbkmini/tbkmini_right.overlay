/*
 * Copyright (c) 2021 Casey Webster
 *
 * SPDX-License-Identifier: MIT
 */

#include "tbkmini.dtsi"

&kscan0 {
	col-gpios
		= <&gpio0 19 (GPIO_ACTIVE_HIGH | GPIO_PULL_DOWN)>
		, <&gpio0 18 (GPIO_ACTIVE_HIGH | GPIO_PULL_DOWN)>
		, <&gpio0 15 (GPIO_ACTIVE_HIGH | GPIO_PULL_DOWN)>
		, <&gpio0 14 (GPIO_ACTIVE_HIGH | GPIO_PULL_DOWN)>
		, <&gpio0 16 (GPIO_ACTIVE_HIGH | GPIO_PULL_DOWN)>
		;
};
