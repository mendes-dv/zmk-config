## config/boards/shields/cygnus/Kconfig.shield
```kconfig
config SHIELD_CYGNUS_LEFT
    def_bool $(shields_list_contains,cygnus_left)
        select SHIELD_CYGNUS

config SHIELD_CYGNUS_RIGHT
    def_bool $(shields_list_contains,cygnus_right)
        select SHIELD_CYGNUS
```

## config/boards/shields/tbkmini/Kconfig.defconfig
```kconfig
if SHIELD_TBKMINI_LEFT

config ZMK_KEYBOARD_NAME
    default "tbkmini"

config ZMK_SPLIT_BLE_ROLE_CENTRAL
    default y
    
config ZMK_SPLIT_USB
    default y

endif

if SHIELD_TBKMINI_LEFT || SHIELD_TBKMINI_RIGHT

config ZMK_SPLIT
    default y

endif
```

## config/west.yml
```yaml
manifest:
  remotes:
    - name: zmkfirmware
      url-base: https://github.com/zmkfirmware
    - name: module_a_base
      url-base: https://github.com/ftc
  projects:
    - name: zmk
      remote: zmkfirmware
      revision: main
      import: app/west.yml
    - name: module_a
      remote: zmkfirmware
      revision: mouse-ftc
  self:
    path: config 
```
